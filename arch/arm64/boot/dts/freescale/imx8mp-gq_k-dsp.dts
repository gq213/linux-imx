// SPDX-License-Identifier: GPL-2.0+
// Copyright NXP 2021

#include "imx8mp-gq_k.dts"

&dsp {
	pinctrl-names = "default";
	pinctrl-0 = <&pinctrl_uart4>;
	clocks = <&audio_blk_ctrl IMX8MP_CLK_AUDIO_BLK_CTRL_OCRAMA_IPG>,
			 <&audio_blk_ctrl IMX8MP_CLK_AUDIO_BLK_CTRL_DSP_ROOT>,
			 <&audio_blk_ctrl IMX8MP_CLK_AUDIO_BLK_CTRL_DSPDBG_ROOT>,
			 <&clk IMX8MP_CLK_UART4_ROOT>;
	clock-names = "ocram", "core", "debug",
				  "ipg";
	status = "okay";
};

&uart4 {
	status = "disabled";
};
